## Boards/kamoamoa/cpap_pi_body/Kconfig.cpap_pi_body
```kconfig
config BOARD_CPAP_PI_BODY
	select SOC_NRF52840_QIAA if BOARD_CPAP_PI_BODY_NRF52840
```

## Boards/kamoamoa/cpap_pi_control/Kconfig.cpap_pi_control
```kconfig
config BOARD_CPAP_PI_CONTROL
	select SOC_NRF52840_QIAA if BOARD_CPAP_PI_CONTROL_NRF52840
	select BOARD_EARLY_INIT_HOOK
```

## Boards/kamoamoa/cpap_pi_control/cpap_pi_control_nrf52840_defconfig
```kconfig
# Enable GPIO and MPU
CONFIG_GPIO=y
CONFIG_ARM_MPU=y

# Subsystem defaults for CPAP PI Sensor Control hardware
CONFIG_I2C=y
CONFIG_SPI=y
CONFIG_ADC=y

# Disable UART, Enable Segger RTT for Debug
CONFIG_SERIAL=n
CONFIG_USE_SEGGER_RTT=y
CONFIG_RTT_CONSOLE=y
CONFIG_CONSOLE=y

# 32.768 kHz crystal (X2) present on this board
CONFIG_CLOCK_CONTROL_NRF_K32SRC_XTAL=y
```
